## boards/arm/stm32h747i_disco/Kconfig.defconfig
```kconfig
# STM32H747I DISCOVERY board configuration

# Copyright (c) 2019 Linaro Limited
# SPDX-License-Identifier: Apache-2.0

if BOARD_STM32H747I_DISCO_M7 || BOARD_STM32H747I_DISCO_M4

config BOARD
	default "stm32h747i_disco_m7" if BOARD_STM32H747I_DISCO_M7
	default "stm32h747i_disco_m4" if BOARD_STM32H747I_DISCO_M4

# clock configuration
config SYS_CLOCK_HW_CYCLES_PER_SEC
	default 400000000 if BOARD_STM32H747I_DISCO_M7
	# SYS_CLOCK_M4 = SYS_CLOCK_M7 / CLOCK_STM32_HPRE
	default 200000000 if BOARD_STM32H747I_DISCO_M4

config CLOCK_STM32_D1CPRE
	default 1

config CLOCK_STM32_HPRE
	# HCLK: 200MHz
	default 2

config CLOCK_STM32_D2PPRE1
	# APBX: 100MHz
	default 2

config CLOCK_STM32_D2PPRE2
	default 2

config CLOCK_STM32_D1PPRE
	default 2

config CLOCK_STM32_D3PPRE
	default 2

config STM32H7_DUAL_CORE
	default y

config DISK_ACCESS_STM32_SDMMC
	default n

config DISK_ACCESS_STM32_CLOCK_SOURCE_PLL2_R

# PLL2_VCO Input = HSE_VALUE/PLL2_M = 5 Mhz
# PLL2_VCO Output = PLL2_VCO Input * PLL_N = 500 Mhz
# SDMMC Kernel Clock = PLL2_VCO Output/PLL_R = 500/5 = 100 Mhz

config CLOCK_STM32_PLL2_M_DIVISOR
	default 5

config CLOCK_STM32_PLL2_N_MULTIPLIER
	default 100

config CLOCK_STM32_PLL2_P_ENABLE
	default y

config CLOCK_STM32_PLL2_R_DIVISOR
	default 5

if NETWORKING

config NET_L2_ETHERNET
	default y

endif # NETWORKING

endif # BOARD_STM32H747I_DISCO_M7
```

## dts/bindings/mtd/jesd216.yaml
```yaml
# Copyright (c) 2018 Peter Bigot Consulting, LLC
# Copyright (c) 2019 Nordic Semiconductor ASA
# SPDX-License-Identifier: Apache-2.0

# Common properties used by nodes describing M25P80-compatible SPI NOR
# serial flash devices.

properties:
  jedec-id:
    type: uint8-array
    required: false
    description: JEDEC ID as manufacturer ID, memory type, memory density

  sfdp-bfp:
    type: uint8-array
    required: false
    description: |
      Contains the 32-bit words in little-endian byte order from the
      JESD216 Serial Flash Discoverable Parameters Basic Flash
      Parameters table.  This provides flash-specific configuration
      information in cases were runtime configuration is not desired.

  size:
    type: int
    required: false
    description: flash capacity in bits
```
